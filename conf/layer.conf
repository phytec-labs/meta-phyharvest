## conf/layer.conf
```bitbake
# We have a conf and classes directory, add to BBPATH
BBPATH .= ":${LAYERDIR}"

# We have recipes-* directories, add to BBFILES
BBFILES += "${LAYERDIR}/recipes-*/*/*.bb \
            ${LAYERDIR}/recipes-*/*/*.bbappend"

BBFILE_COLLECTIONS += "meta-phyharvest"
BBFILE_PATTERN_meta-phyharvest = "^${LAYERDIR}/"
BBFILE_PRIORITY_meta-phyharvest = "21"

LAYERDEPENDS_meta-phyharvest = "core"
LAYERSERIES_COMPAT_meta-phyharvest = "scarthgap"
```
